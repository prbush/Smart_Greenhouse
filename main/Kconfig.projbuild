## main/Kconfig.projbuild
```kconfig
menu "Macro Configuration"

    orsource "$IDF_PATH/examples/common_components/env_caps/$IDF_TARGET/Kconfig.env_caps"

    choice BLINK_LED
        prompt "Blink LED type"
        default BLINK_LED_GPIO if IDF_TARGET_ESP32 || !SOC_RMT_SUPPORTED
        default BLINK_LED_RMT
        help
            Defines the default peripheral for blink example

        config BLINK_LED_GPIO
            bool "GPIO"
        config BLINK_LED_RMT
            bool "RMT - Addressable LED"
    endchoice

    config ESP_WIFI_SSID
        string "WiFi SSID"
        default "QF-B02A6E"
        help
            SSID (network name) for the example to connect to.

    config ESP_WIFI_PASSWORD
        string "WiFi Password"
        default "NQfb2023"
        help
            WiFi password (WPA or WPA2) for the example to use.

    choice ESP_WIFI_SAE_MODE
        prompt "WPA3 SAE mode selection"
        default ESP_WPA3_SAE_PWE_BOTH
        help
            Select mode for SAE as Hunt and Peck, H2E or both.
        config ESP_WPA3_SAE_PWE_HUNT_AND_PECK
            bool "HUNT AND PECK"
        config ESP_WPA3_SAE_PWE_HASH_TO_ELEMENT
            bool "H2E"
        config ESP_WPA3_SAE_PWE_BOTH
            bool "BOTH"
    endchoice

    config ESP_WIFI_PW_ID
        string "PASSWORD IDENTIFIER"
        depends on  ESP_WPA3_SAE_PWE_HASH_TO_ELEMENT|| ESP_WPA3_SAE_PWE_BOTH
        default ""
        help
            password identifier for SAE H2E

    config ESP_MAXIMUM_RETRY
        int "Maximum retry"
        default 5
        help
            Set the Maximum retry to avoid station reconnecting to the AP unlimited when the AP is really inexistent.

    choice ESP_WIFI_SCAN_AUTH_MODE_THRESHOLD
        prompt "WiFi Scan auth mode threshold"
        default ESP_WIFI_AUTH_WPA2_PSK
        help
            The weakest authmode to accept in the scan mode.
            This value defaults to ESP_WIFI_AUTH_WPA2_PSK incase password is present and ESP_WIFI_AUTH_OPEN is used.
            Please select ESP_WIFI_AUTH_WEP/ESP_WIFI_AUTH_WPA_PSK incase AP is operating in WEP/WPA mode.

        config ESP_WIFI_AUTH_OPEN
            bool "OPEN"
        config ESP_WIFI_AUTH_WEP
            bool "WEP"
        config ESP_WIFI_AUTH_WPA_PSK
            bool "WPA PSK"
        config ESP_WIFI_AUTH_WPA2_PSK
            bool "WPA2 PSK"
        config ESP_WIFI_AUTH_WPA_WPA2_PSK
            bool "WPA/WPA2 PSK"
        config ESP_WIFI_AUTH_WPA3_PSK
            bool "WPA3 PSK"
        config ESP_WIFI_AUTH_WPA2_WPA3_PSK
            bool "WPA2/WPA3 PSK"
        config ESP_WIFI_AUTH_WAPI_PSK
            bool "WAPI PSK"
    endchoice

    config BLINK_GPIO
        int "Blink GPIO number"
        range ENV_GPIO_RANGE_MIN ENV_GPIO_OUT_RANGE_MAX
        default 5 if IDF_TARGET_ESP32
        default 18 if IDF_TARGET_ESP32S2
        default 48 if IDF_TARGET_ESP32S3
        default 8
        help
            GPIO number (IOxx) to blink on and off or the RMT signal for the addressable LED.
            Some GPIOs are used for other purposes (flash connections, etc.) and cannot be used to blink.

    config FAN_GPIO
        int "GPIO output pin for fan"
        range ENV_GPIO_RANGE_MIN ENV_GPIO_OUT_RANGE_MAX
        default 18
        help
            GPIO pin number to be used for toggling Fan FET.

    config LIGHTS_GPIO
        int "GPIO output pin for lights"
        range ENV_GPIO_RANGE_MIN ENV_GPIO_OUT_RANGE_MAX
        default 15
        help
            GPIO pin number to be used for toggling Lights FET.

    config PDLC_GPIO
        int "GPIO output pin for PDLC"
        range ENV_GPIO_RANGE_MIN ENV_GPIO_OUT_RANGE_MAX
        default 40
        help
            GPIO pin number to be used for toggling PDLC FET.

    config SNTP_TIME_SERVER
        string "SNTP server name"
        default "pool.ntp.org"
        help
            Hostname of the main SNTP server.

    config I2C_MASTER_SCL
        int "GPIO pin for I2C master SCL"
        default 2
        help
            GPIO pin for I2C master clock line.

    config I2C_MASTER_SDA
        int "GPIO pin for I2C master SDA"
        default 42
        help
            GPIO pin for I2C master data line.

    config I2C_MASTER_NUM
        int "Instance (port) number for I2C master."
        default 0
        help
            Port number for I2C master.

    choice I2C_MASTER_FREQ_HZ
        prompt "I2C master frequency (Hz)."
        default I2C_FAST_MODE
        help
            Bus speed for I2C master.

        config I2C_STANDARD_MODE
            int "Standard speed 100kHz"
            default 100000
        config I2C_FAST_MODE
            int "Fast speed 400kHz" 
            default 400000
    endchoice 

    config I2C_MASTER_TX_BUF
        int "Size of I2C master Tx Buffer."
        default 0
        help
            Transmit buffer size for I2C master.

    config I2C_MASTER_RX_BUF
        int "Size of I2C master Rx Buffer."
        default 0
        help
            Receive buffer size for I2C master.

    config I2C_MASTER_TIMEOUT_MS
        int "Timeout in ms for I2C transaction."
        default 2500
        help
            Max time for an I2C transaction to occur before failing out.

    config SOIL_SENSOR_ADC_CHANNEL
        int "ADC channel for soil sensor."
        default 0
        help
            Soil sensor ADC channel.

    config SOIL_SENSOR_ADC_UNIT
        int "Soil sensor ADC unit: ADC Unit 1 = 0, ADC Unit 2 = 1"
        default 0
        help
            Soil sensor ADC unit assignment.
        

    choice SNTP_TIME_SYNC_METHOD
        prompt "Time synchronization method"
        default SNTP_TIME_SYNC_METHOD_IMMED
        help
            Time synchronization method.

        config SNTP_TIME_SYNC_METHOD_IMMED
            bool "update time immediately when received"
        config SNTP_TIME_SYNC_METHOD_SMOOTH
            bool "update time with smooth method (adjtime)"
        config SNTP_TIME_SYNC_METHOD_CUSTOM
            bool "custom implementation"
    endchoice

endmenu
```
